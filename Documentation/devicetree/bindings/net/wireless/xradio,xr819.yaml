## Documentation/devicetree/bindings/net/wireless/xradio,xr819.yaml
```yaml
# SPDX-License-Identifier: (GPL-2.0-only OR BSD-2-Clause)
%YAML 1.2
---
$id: http://devicetree.org/schemas/net/wireless/xradio,xr819.yaml#
$schema: http://devicetree.org/meta-schemas/core.yaml#

title: XRadio XR819 SDIO wireless controller

maintainers:
  - linux-wireless@vger.kernel.org

description:
  The XR819 is a 2.4 GHz IEEE 802.11b/g/n controller connected to the host
  through SDIO. Its out-of-band interrupt may be connected to a host GPIO.

properties:
  compatible:
    const: xradio,xr819

  reg:
    const: 1

  interrupts:
    maxItems: 1

  local-mac-address: true

required:
  - compatible
  - reg

additionalProperties: false

examples:
  - |
    #include <dt-bindings/interrupt-controller/irq.h>

    mmc {
        #address-cells = <1>;
        #size-cells = <0>;

        wifi@1 {
            compatible = "xradio,xr819";
            reg = <1>;
            interrupt-parent = <&pio>;
            interrupts = <10 IRQ_TYPE_EDGE_RISING>;
            local-mac-address = [02 00 00 00 00 01];
        };
    };
```
